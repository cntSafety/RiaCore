AUTOSAR XML (schema 00046)
standard types defined: boolean, uint8, uint16, uint32, sint32, float32
