AUTOSAR XML (schema 00046)
package /Systems
  system System
    root-software-compositions:
      root sw composition prototype RootSwComposition: software-composition=TigerDetectionComposition
